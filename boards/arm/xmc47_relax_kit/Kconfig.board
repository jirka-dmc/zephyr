## boards/arm/xmc47_relax_kit/Kconfig.board
```kconfig
# SPDX-License-Identifier: Apache-2.0
#
# Copyright (c) 2020 Linumiz
# Author: Parthiban Nallathambi <parthiban@linumiz.com>

config BOARD_XMC47_RELAX_KIT
	bool "Infineon XMC4700 Relax Kit"
	depends on SOC_SERIES_XMC_4XXX
	select SOC_PART_NUMBER_F144X2048
	select XMC4XXX_CCM
```

## boards/arm/xmc47_relax_kit/Kconfig.defconfig
```kconfig
# SPDX-License-Identifier: Apache-2.0
#
# Copyright (c) 2020 Linumiz
# Author: Parthiban Nallathambi <parthiban@linumiz.com>

if BOARD_XMC47_RELAX_KIT

config BOARD
	default "xmc47_relax_kit"

endif # BOARD_XMC47_RELAX_KIT
```

## boards/arm/xmc47_relax_kit/xmc47_relax_kit_defconfig
```kconfig
# SPDX-License-Identifier: Apache-2.0
#
# Copyright (c) 2020 Linumiz
# Author: Parthiban Nallathambi <parthiban@linumiz.com>

CONFIG_BOARD_XMC47_RELAX_KIT=y
CONFIG_SOC_SERIES_XMC_4XXX=y
CONFIG_SOC_XMC4700=y
CONFIG_CORTEX_M_SYSTICK=y
CONFIG_ARM_MPU=y
```

## drivers/gpio/Kconfig.xmc4xxx
```kconfig
# Infineon

config GPIO_XMC4XXX
	depends on SOC_SERIES_XMC_4XXX
	bool "XMC4XX GPIO driver"
	depends on SOC_FAMILY_XMC && HAS_XMCLIB_GPIO
	help
	  This option enables the XMC4XX GPIO driver
```

## drivers/interrupt_controller/Kconfig.xmc4xxx
```kconfig
# Infineon

config EXTI_XMC4XXX
	bool "External Interrupt Controller (EXTI) Driver for Infineon XMC4XXX series devices"
	default y
	depends on SOC_FAMILY_XMC
	help
	  Enable EXTI driver for XMC4XXX series of devices.  This is required for
	  GPIO interrupt support.
```

## dts/bindings/gpio/infineon,xmc4xxx-gpio.yaml
```yaml
description: INFINEON XMC4XXX GPIO

compatible: "infineon,xmc4xxx-gpio"

include: [gpio-controller.yaml, base.yaml]

properties:
    reg:
      required: true

    label:
      required: true
    
    pin-mask:
      required: true
      type: int

    "#gpio-cells":
      const: 2

gpio-cells:
  - pin
  - flags
```
